// SPDX-License-Identifier: GPL-2.0-only
/*
 * Battery device tree entries specific to raven
 *
 * Copyright 2022 Google,LLC
 *
 */

&google_battery {
	google,chg-battery-capacity = <4300>;

	google,ttf-temp-idx= <2>;
	google,ttf-adapter = <1980>;
	google,ttf-soc-table =  <55 63 77 87 89  92  96 100>;
	google,ttf-elap-table = <40 46 54 73 84 104 150 213>;
	google,ttf-tier-table = <0 65 80>;
};

&max77759_fg {
	/delete-property/ maxim,force-batt-id;

	maxim,rc-enable;
	maxim,rc-soc = <20>;
	maxim,rc-temp = <50>;

	maxim,filtercfg-temp = <100>;
	maxim,filtercfg-temp-hysteresis = <30>;
	maxim,filtercfg-default = /bits/ 16 <0xc613>;
	maxim,filtercfg-adjust = /bits/ 16 <0xc615>;
	maxim,fg-data {
		#include "gs201-lynx-battery-data.dtsi"
	};
};
